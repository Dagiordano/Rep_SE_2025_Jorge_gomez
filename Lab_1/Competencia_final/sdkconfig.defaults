## Lab_1/Competencia_final/sdkconfig.defaults
```kconfig
CONFIG_SPIFFS_MAX_PARTITIONS=3
CONFIG_SPIFFS_FIND_ALGO_LINEAR=y
CONFIG_SPIFFS_CACHE=y
CONFIG_SPIFFS_CACHE_WR=y
CONFIG_SPIFFS_CACHE_STATS=n
CONFIG_SPIFFS_PAGE_CHECK=y
CONFIG_SPIFFS_GC_MAX_RUNS=10
CONFIG_SPIFFS_GC_STATS=n
CONFIG_SPIFFS_PAGE_SIZE=256
CONFIG_SPIFFS_OBJ_NAME_LEN=32
CONFIG_SPIFFS_FOLLOW_SYMLINKS=n
CONFIG_SPIFFS_USE_MAGIC=y
CONFIG_SPIFFS_USE_MAGIC_LENGTH=y
CONFIG_SPIFFS_META_LENGTH=4
CONFIG_SPIFFS_USE_MTIME=y
CONFIG_SPIFFS_DBG=n
CONFIG_SPIFFS_API_DBG=n
CONFIG_SPIFFS_GC_DBG=n
CONFIG_SPIFFS_CACHE_DBG=n
CONFIG_SPIFFS_CHECK_DBG=n
CONFIG_SPIFFS_TEST_VISUALIZE=n 
```

## Lab_2/Ejercicio_Final/codigo_ejercicioFinal/sdkconfig.defaults
```kconfig
# Enable ESP-PM
CONFIG_PM_ENABLE=y

# Camera configuration
CONFIG_CAMERA_TASK_STACK_SIZE=8192

# Increase main task stack size to prevent overflow
CONFIG_ESP_MAIN_TASK_STACK_SIZE=16384

# PSRAM configuration
CONFIG_ESP32_SPIRAM_SUPPORT=y
CONFIG_SPIRAM_BOOT_INIT=y
CONFIG_SPIRAM=y
CONFIG_ESP32_SPIRAM=y
CONFIG_SPIRAM_USE=y
CONFIG_SPIRAM_TYPE_AUTO=y
CONFIG_SPIRAM_SIZE=-1
CONFIG_SPIRAM_SPEED_40M=y
CONFIG_ESP32_SPIRAM_CACHE_WORKAROUND=y
CONFIG_SPIRAM_MALLOC_ALWAYSINTERNAL=16384
CONFIG_SPIRAM_MALLOC_RESERVE_INTERNAL=32768

# Memory settings
CONFIG_ESP32_MEMMAP_TRACEMEM=n
CONFIG_ESP32_MEMMAP_TRACEMEM_TWOBANKS=n
CONFIG_ESP32_TRAX=n
CONFIG_ESP32_TRACEMEM_RESERVE_DRAM=0x0

# Higher log level for development
CONFIG_LOG_DEFAULT_LEVEL_INFO=y

# Allow multiple tasks to use the SPI driver simultaneously
CONFIG_SPI_MASTER_ISR_IN_IRAM=y

# Remove unused SD card configuration 
# CONFIG_SDMMC_FREQ_HIGHSPEED=y 
```
